## drivers/misc/mediatek/accelerometer/KXTJ2_1009_pixi4_5/Kconfig
```kconfig
config MTK_KXTJ2_1009_PIXI4_5
	bool "KXTJ2_1009 for MediaTek package"
	default n
	help
	  It support different accelerometer sensor.
          If this option is set,
	  it will support
          KXTJ2_1009 Accelerometer.
```

## drivers/misc/mediatek/accelerometer/bma222E_pixi4_5/Kconfig
```kconfig
config MTK_BMA222E_PIXI4_5
	bool "MTK_BMA222E_PIXI4_5 for MediaTek package"
	default n
	help
	  It support different accelerometer sensor.
          If this option is set,
	  it will support
          MTK_BMA222E_PIXI4_5 Accelerometer.

config BMA222_LOWPASS
	bool "MTK_BMA222E_PIXI4_5 for Mediatek package"
	default n
	help
	Say Y here if you have MTK_BMA222E_PIXI4_5 touch panel BMA222_LOWPASS.

	If unsure, say N.

	To compile this dirver as a module, choose M here: the
	module will be called.

config CUSTOM_KERNEL_SENSORHUB
	bool "MTK_BMA222E_PIXI4_5 for Mediatek package"
	default n
	help
	Say Y here if you have MTK_BMA222E_PIXI4_5 touch panel CUSTOM_KERNEL_SENSORHUB.

	If unsure, say N.

	To compile this dirver as a module, choose M here: the
	module will be called.
```

## drivers/misc/mediatek/accelerometer/bma253_pixi4_5/Kconfig
```kconfig
config MTK_BMA253_PIXI4_5
	bool "BMA253 for MediaTek package"
	default n
	help
	  It support different accelerometer sensor.
          If this option is set,
	  it will support
          BMA253 Accelerometer.
```

## drivers/misc/mediatek/alsps/ctp_alsps/Kconfig
```kconfig
config CTP_ALSPS
	bool "CTP_ALSPS for MediaTek package"
	default n
	help
	It support different type sensor
	in this platform. If this option
	is set, it will support CTP_ALSPS.
```
